## components/apps/Kconfig.projbuild
```kconfig
menu "OS apps"

config OS_APP_SETTINGS
    bool "Settings"
    default y

config OS_APP_DIAG
    bool "Diagnostics"
    default y

config OS_APP_FILES
    bool "File explorer (microSD)"
    default y

config OS_APP_MUSIC
    bool "Music player"
    default y

config OS_APP_LED
    bool "RGB LED control"
    default y

config OS_APP_RECORDER
    bool "Voice recorder"
    default y

endmenu
```

## components/os_core/Kconfig.projbuild
```kconfig
menu "OS core"

config OS_DEBUG_RADIOS
    bool "Turn Wi-Fi and BLE on at boot and log the heap (memory measurements)"
    default n

endmenu
```

## components/os_ui/Kconfig.projbuild
```kconfig
menu "OS UI"

config OS_UI_STRIP_ROWS
    int "Render strip height in rows (multiple of 4)"
    default 80
    range 8 160

config OS_UI_BUF_PSRAM
    bool "Allocate the LVGL render buffer in PSRAM instead of internal SRAM"
    default y

config OS_UI_TX_CHUNK_BYTES
    int "Size of each of the two DMA transmit buffers in internal SRAM (bytes)"
    default 16384
    range 4096 65536
    help
        A rendered strip is rotated and sent in chunks of this size. Two buffers are
        used so the CPU rotates one chunk while the DMA sends the other.

config OS_UI_PCLK_MHZ
    int "QSPI pixel clock (MHz)"
    default 80
    range 10 80

config OS_UI_FLUSH_BENCH
    bool "Run a full-screen flush benchmark at start-up"
    default n

endmenu
```

## components/svc_audio/Kconfig.projbuild
```kconfig
menu "Audio engine"

config SVC_AUDIO_BOOT_BEEP
    bool "Play a test tone 4 s after boot (hardware bring-up)"
    default n

endmenu

menu "Voice recorder"

config SVC_REC_MIC_PGA
    int "ES8311 analog mic PGA gain (register 0x14 bits 3:0, 0..10 = 0..30 dB)"
    range 0 10
    default 10

config SVC_REC_ADC_SCALE
    int "ES8311 ADC gain scale-up (register 0x16 bits 2:0, 0..7 = 0..42 dB in 6 dB steps)"
    range 0 7
    default 4

config SVC_REC_ADC_VOLUME
    hex "ES8311 ADC digital volume (register 0x17, 0xBF = 0 dB, 0.5 dB per step)"
    range 0x00 0xFF
    default 0xBF

endmenu
```

## sdkconfig.defaults.diag
```kconfig
# Diagnostics build
CONFIG_LOG_DEFAULT_LEVEL_INFO=y
CONFIG_FREERTOS_GENERATE_RUN_TIME_STATS=y
CONFIG_FREERTOS_USE_TRACE_FACILITY=y
CONFIG_LV_USE_SYSMON=y
CONFIG_LV_USE_PERF_MONITOR=y
CONFIG_LV_BUILD_DEMOS=y
CONFIG_LV_USE_DEMO_BENCHMARK=y
```
